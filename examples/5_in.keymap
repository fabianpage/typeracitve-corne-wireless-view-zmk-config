/ {
    behaviors {
        compatible = "zmk,behaviors";

        // BEGIN behaviors
        // END behaviors
    };

    keymap {
        compatible = "zmk,keymap";

        // BEGIN keymap
        // END keymap
    };
};
